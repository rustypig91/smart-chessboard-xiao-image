## prj.conf
```kconfig
# Enable debug options
CONFIG_DEBUG=y
CONFIG_ASSERT=y

CONFIG_SERIAL=y
CONFIG_CONSOLE=y
CONFIG_UART_CONSOLE=y
CONFIG_STDOUT_CONSOLE=y
CONFIG_UART_LINE_CTRL=y

# CDC ACM Uart
CONFIG_USB_DEVICE_STACK_NEXT=y
CONFIG_CDC_ACM_SERIAL_INITIALIZE_AT_BOOT=y
CONFIG_CDC_ACM_SERIAL_PRODUCT_STRING="Chessboard console"
CONFIG_CDC_ACM_SERIAL_PID=0x0004
CONFIG_SHELL_BACKEND_SERIAL_CHECK_DTR=n
CONFIG_USBD_CDC_ACM_LOG_LEVEL_OFF=y
CONFIG_UART_LINE_CTRL=y

#CONFIG_LED=y
#CONFIG_INPUT=y
CONFIG_ADC=y

CONFIG_SHELL=y
CONFIG_SHELL_BACKENDS=y
CONFIG_SHELL_BACKEND_SERIAL=y
CONFIG_SHELL_PROMPT_UART="chess:~$ "
CONFIG_SHELL_VT100_COLORS=n
CONFIG_SHELL_PRINTF_BUFF_SIZE=1024
CONFIG_SHELL_THREAD_PRIORITY_OVERRIDE=y
CONFIG_SHELL_THREAD_PRIORITY=14
CONFIG_MAIN_THREAD_PRIORITY=14

CONFIG_CONSOLE_SUBSYS=y
CONFIG_CONSOLE_GETCHAR=y



CONFIG_LOG=y
CONFIG_LOG_DEFAULT_LEVEL=2
CONFIG_USBD_CDC_ACM_LOG_LEVEL_OFF=y
CONFIG_LOG_CMDS=y


# For storing calibration data
CONFIG_FLASH=y
CONFIG_FLASH_MAP=y
CONFIG_SETTINGS_RUNTIME=y
CONFIG_SETTINGS=y
CONFIG_NVS=y
CONFIG_SETTINGS_NVS=y
CONFIG_SETTINGS_SHELL=y
CONFIG_MPU_ALLOW_FLASH_WRITE=y

# Watchdog
CONFIG_WATCHDOG=y
CONFIG_WDT_DISABLE_AT_BOOT=n
```

## shell.conf
```kconfig
CONFIG_SHELL=y

CONFIG_LOG=y
CONFIG_LOG_DEFAULT_LEVEL=2

# Shell commands
CONFIG_LOG_CMDS=y
CONFIG_KERNEL_SHELL=y
CONFIG_DEVICE_SHELL=y
CONFIG_LED_SHELL=y
CONFIG_ADC_SHELL=y
```

## src/chessboard.c
```c
#include "chessboard.h"
#include "chessboard_calibration.h"

#include <zephyr/kernel.h>

#include <zephyr/drivers/adc.h>
#include <zephyr/device.h>
#include <zephyr/devicetree.h>
#include <zephyr/drivers/gpio.h>
#include <zephyr/logging/log.h>

LOG_MODULE_REGISTER(chessboard, LOG_LEVEL_INF);

#define HAL_SENSOR_OCCUPIED_OFFSET_MV   (int32_t)100
#define HAL_SENSOR_UNOCCUPIED_OFFSET_MV (HAL_SENSOR_OCCUPIED_OFFSET_MV * 2 / 3)
#define HAL_NUM_MEASUREMENTS            (uint8_t)32

#define GET_INDEX(file, rank) ((rank) * 8 + (file))

#define DT_SPEC_AND_COMMA(node_id, prop, idx) ADC_DT_SPEC_GET_BY_IDX(node_id, idx),

static const struct gpio_dt_spec channel_select_a =
	GPIO_DT_SPEC_GET(DT_ALIAS(channel_select_a), gpios);
static const struct gpio_dt_spec channel_select_b =
	GPIO_DT_SPEC_GET(DT_ALIAS(channel_select_b), gpios);
static const struct gpio_dt_spec channel_select_c =
	GPIO_DT_SPEC_GET(DT_ALIAS(channel_select_c), gpios);

/* Mapping of chess board rows to multiplexer channels */
static uint8_t multiplexer_mapping[8][8] = {
	// [Multiplexer][Channel] = Board row
	{2, 1, 0, 3, 4, 7, 5, 6}, // A - Normal
	{6, 5, 4, 7, 3, 0, 2, 1}, // B - Mirrored
	{2, 1, 0, 3, 4, 7, 5, 6}, // C - Normal
	{6, 5, 4, 7, 3, 0, 2, 1}, // D - Mirrored
	{1, 2, 3, 0, 4, 7, 5, 6}, // E - Normal
	{6, 5, 4, 7, 3, 0, 2, 1}, // F - Mirrored
	{1, 2, 3, 0, 4, 7, 5, 6}, // G - Normal
	{6, 5, 4, 7, 3, 0, 2, 1}, // H - Mirrored
};

static bool hal_sensor_inverted[8] = {
	false, true, false, true, false, true, false, true,
};

/* Data of ADC io-channels specified in devicetree. */
static const struct adc_dt_spec adc_channels[] = {
	DT_FOREACH_PROP_ELEM(DT_PATH(zephyr_user), io_channels, DT_SPEC_AND_COMMA)};

static CHESS_PIECE chess_pieces[64] = {CHESS_PIECE_NONE};
static int32_t chess_pieces_mv[64] = {0};

static int select_multiplexer_channel(uint8_t channel);
static int read_adc_channel(const int index, int32_t *val_mv, uint8_t num_measurements);

int chessboard_scan_file(uint8_t file)
{
	if (file > 7) {
		return -EINVAL;
	}

	CHESS_PIECE piece;
	int32_t offset;
	for (int multiplexer_channel = 0; multiplexer_channel < 8; multiplexer_channel++) {

		int ret = select_multiplexer_channel(multiplexer_channel);

		if (ret != 0) {
			LOG_ERR("Failed to select multiplexer channel %d: %d", multiplexer_channel,
				ret);
			return ret;
		}

		int32_t val_mv;
		ret = read_adc_channel(file, &val_mv, HAL_NUM_MEASUREMENTS);
		if (ret < 0) {
			LOG_ERR("Failed to read ADC channel %d (err %d)", file, ret);
			return ret;
		}

		if (hal_sensor_inverted[file]) {
			val_mv = -val_mv;
		}

		int rank = multiplexer_mapping[file][multiplexer_channel];

		const int index = GET_INDEX(file, rank);

		chess_pieces_mv[index] = val_mv;
		offset = chessboard_calibration_get_mv(file, rank) - val_mv;

		if (offset < (-HAL_SENSOR_OCCUPIED_OFFSET_MV)) {
			piece = CHESS_PIECE_BLACK;
		} else if (offset > (HAL_SENSOR_OCCUPIED_OFFSET_MV)) {
			piece = CHESS_PIECE_WHITE;
		} else if ((offset >= (-HAL_SENSOR_UNOCCUPIED_OFFSET_MV)) &&
			   (offset <= (HAL_SENSOR_UNOCCUPIED_OFFSET_MV))) {
			piece = CHESS_PIECE_NONE;
		} else {
			/*
			 * This ensures that noise around the threshold values does not
			 * cause constant changes between states.
			 */
			piece = chess_pieces[index];
		}

		chess_pieces[index] = piece;

		if (ret != 0) {
			LOG_ERR("Error reading square %02d: %d", index, ret);
		}
	}
	return 0;
}

int chessboard_scan(void)
{
	CHESS_PIECE piece;
	int32_t offset;
	for (int multiplexer_channel = 0; multiplexer_channel < 8; multiplexer_channel++) {

		int ret = select_multiplexer_channel(multiplexer_channel);

		if (ret != 0) {
			LOG_ERR("Failed to select multiplexer channel %d: %d", multiplexer_channel,
				ret);
			return ret;
		}

		for (int file = 0; file < 8; file++) {

			int32_t val_mv;
			ret = read_adc_channel(file, &val_mv, HAL_NUM_MEASUREMENTS);
			if (ret < 0) {
				LOG_ERR("Failed to read ADC channel %d (err %d)", file, ret);
				return ret;
			}

			if (hal_sensor_inverted[file]) {
				val_mv = -val_mv;
			}

			int rank = multiplexer_mapping[file][multiplexer_channel];

			const int index = GET_INDEX(file, rank);

			chess_pieces_mv[index] = val_mv;
			offset = chessboard_calibration_get_mv(file, rank) - val_mv;

			if (offset < (-HAL_SENSOR_OCCUPIED_OFFSET_MV)) {
				piece = CHESS_PIECE_BLACK;
			} else if (offset > (HAL_SENSOR_OCCUPIED_OFFSET_MV)) {
				piece = CHESS_PIECE_WHITE;
			} else if ((offset >= (-HAL_SENSOR_UNOCCUPIED_OFFSET_MV)) &&
				   (offset <= (HAL_SENSOR_UNOCCUPIED_OFFSET_MV))) {
				piece = CHESS_PIECE_NONE;
			} else {
				/*
				 * This ensures that noise around the threshold values does not
				 * cause constant changes between states.
				 */
				piece = chess_pieces[index];
			}

			chess_pieces[index] = piece;

			if (ret != 0) {
				LOG_ERR("Error reading square %02d: %d", index, ret);
			}
		}
	}
	return 0;
}

int32_t chessboard_get_mv(uint8_t file, uint8_t rank)
{
	if (file > 7 || rank > 7) {
		return -1;
	}

	return chess_pieces_mv[GET_INDEX(file, rank)];
}

int32_t chessboard_get_mv_offset(uint8_t file, uint8_t rank)
{
	if (file > 7 || rank > 7) {
		return -1;
	}
	int index = GET_INDEX(file, rank);
	return chessboard_calibration_get_mv(file, rank) - chess_pieces_mv[index];
}

CHESS_PIECE chessboard_get_color(uint8_t file, uint8_t rank)
{
	if (file > 7 || rank > 7) {
		return CHESS_PIECE_NONE;
	}
	return chess_pieces[GET_INDEX(file, rank)];
}

static int select_multiplexer_channel(uint8_t channel)
{
	int ret;
	const struct gpio_dt_spec *channels[] = {&channel_select_a, &channel_select_b,
						 &channel_select_c};

	static bool is_initialized = false;
	if (!is_initialized) {
		for (int i = 0; i < 3; i++) {
			if (!gpio_is_ready_dt(channels[i])) {
				return -ENODEV;
			}
			ret = gpio_pin_configure_dt(channels[i], GPIO_OUTPUT_INACTIVE);
			if (ret < 0) {
				return -ENODEV;
			}
		}
		is_initialized = true;
		LOG_INF("Multiplexer channel select pins initialized\n");
	}

	for (int i = 0; i < 3; i++) {
		int value = (channel >> i) & 0x01;
		ret = gpio_pin_set_dt(channels[i], value);
		if (ret < 0) {
			return ret;
		}
	}

	return 0;
}

static int read_adc_channel(const int index, int32_t *val_mv, uint8_t num_measurements)
{
	if (index >= ARRAY_SIZE(adc_channels)) {
		LOG_ERR("ADC channel index %d out of range", index);
		return 0;
	}

	int32_t buf;
	struct adc_sequence sequence = {
		.buffer = &buf,
		.buffer_size = sizeof(buf),
	};

	if (!adc_is_ready_dt(&adc_channels[index])) {
		LOG_WRN("ADC controller device %s not ready\n", adc_channels[index].dev->name);
		return 0;
	}

	int ret = adc_channel_setup_dt(&adc_channels[index]);
	if (ret < 0) {
		LOG_ERR("Could not setup channel #%d (%d)\n", index, ret);
		return 0;
	}

	ret = adc_sequence_init_dt(&adc_channels[index], &sequence);
	if (ret != 0) {
		LOG_ERR("Could not init sequence for channel #%d (%d)\n", index, ret);
		return ret;
	}

	*val_mv = 0;

	for (uint8_t i = 0; i < num_measurements; i++) {
		ret = adc_read_dt(&adc_channels[index], &sequence);
		if (ret != 0) {
			LOG_ERR("Failed to read ADC channel %d (err %d)", index, ret);
			return ret;
		}
		*val_mv += buf;
	}
	*val_mv /= num_measurements;

	return adc_raw_to_millivolts_dt(&adc_channels[index], val_mv);
}

static int chessboard_setup()
{
	int err = select_multiplexer_channel(0);
	if (err != 0) {
		LOG_ERR("Failed to setup chessboard multiplexer: %d", err);
	}
	return err;
}

SYS_INIT(chessboard_setup, APPLICATION, CONFIG_APPLICATION_INIT_PRIORITY);
```

## src/chessboard.h
```c
#pragma once

#include <stdint.h>

#define CHESS_FILE_A 0
#define CHESS_FILE_B 1
#define CHESS_FILE_C 2
#define CHESS_FILE_D 3
#define CHESS_FILE_E 4
#define CHESS_FILE_F 5
#define CHESS_FILE_G 6
#define CHESS_FILE_H 7

#define CHESS_RANK_1 0
#define CHESS_RANK_2 1
#define CHESS_RANK_3 2
#define CHESS_RANK_4 3
#define CHESS_RANK_5 4
#define CHESS_RANK_6 5
#define CHESS_RANK_7 6
#define CHESS_RANK_8 7

typedef enum {
	CHESS_PIECE_NONE,
	CHESS_PIECE_BLACK,
	CHESS_PIECE_WHITE
} CHESS_PIECE;

int chessboard_scan_file(uint8_t file);
int chessboard_scan(void);
int chessboard_calibrate(void);
int32_t chessboard_get_mv(uint8_t file, uint8_t rank);
int32_t chessboard_get_mv_offset(uint8_t file, uint8_t rank);



CHESS_PIECE chessboard_get_color(uint8_t file, uint8_t rank);
```

## src/chessboard_calibration.c
```c
#include <zephyr/kernel.h>
#include <zephyr/settings/settings.h>
#include "chessboard.h"

#include <zephyr/logging/log.h>
LOG_MODULE_REGISTER(chessboard_calibration, LOG_LEVEL_INF);

static int16_t calibration_offset_mv[8][8] = {
	{1695, 1691, 1709, 1660, 1632, 1755, 1676, 1641},
	{1706, 1684, 1675, 1730, 1632, 1748, 1676, 1633},
	{1694, 1671, 1693, 1660, 1616, 1639, 1623, 1636},
	{1652, 1673, 1721, 1661, 1639, 1629, 1639, 1636},
	{1674, 1733, 1658, 1656, 1645, 1739, 1649, 1625},
	{1678, 1699, 1699, 1715, 1619, 1616, 1689, 1620},
	{1660, 1684, 1654, 1486, 1633, 1613, 1672, 1614},
	{1679, 1684, 1693, 1675, 1489, 1637, 1680, 1644},
};

static int chessboard_calibration_set(const char *name, size_t len, settings_read_cb read_cb,
				      void *cb_arg);

struct settings_handler chessboard_calibration_setting = {.name = "calibration",
							  .h_set = chessboard_calibration_set};

int32_t chessboard_calibration_get_mv(uint8_t file, uint8_t rank)
{
	if (file > 7 || rank > 7) {
		return -1;
	}
	return (int32_t)calibration_offset_mv[rank][file];
}

int chessboard_calibration_calibrate(void)
{
	int ret = chessboard_scan();

	if (ret != 0) {
		return ret;
	}
	int32_t mv;
	for (int rank = 0; rank < 8; rank++) {
		for (int file = 0; file < 8; file++) {
			mv = chessboard_get_mv(file, rank);
			if (mv < INT16_MIN) {
				LOG_ERR("mv reading %d below int16 min at file %d, rank %d", mv,
					file, rank);
				return -EOVERFLOW;
			}

			if (mv > INT16_MAX) {
				LOG_ERR("mv reading %d exceeds int16 max at file %d, rank %d", mv,
					file, rank);
				return -EOVERFLOW;
			}

			calibration_offset_mv[rank][file] = (int16_t)mv;
		}
	}

	ret = settings_save_one("calibration/calibration", &calibration_offset_mv,
				sizeof(calibration_offset_mv));

	if (ret != 0) {
		LOG_ERR("Failed to save calibration data: %d", ret);
	} else {
		LOG_INF("Calibration data saved successfully");
	}

	return ret;
}

static int chessboard_calibration_set(const char *name, size_t len, settings_read_cb read_cb,
				      void *cb_arg)
{
	int rc;

	rc = read_cb(cb_arg, &calibration_offset_mv, sizeof(calibration_offset_mv));
	if (rc >= 0) {
		rc = 0;
	}

	return rc;
}

static int chessboard_calibration_init(void)
{
	int ret;
	ret = settings_subsys_init();
	if (ret != 0) {
		LOG_ERR("Failed to initialize settings subsystem: %d", ret);
		return ret;
	}

	ret = settings_register(&chessboard_calibration_setting);
	if (ret != 0) {
		LOG_ERR("Failed to register settings handler: %d", ret);
		return ret;
	}
	ret = settings_load();
	if (ret != 0) {
		LOG_WRN("No calibration data found, using defaults");
	} else {
		LOG_INF("Calibration data loaded successfully");
	}

	return 0;
}

SYS_INIT(chessboard_calibration_init, APPLICATION, CONFIG_APPLICATION_INIT_PRIORITY);
```

## src/chessboard_calibration.h
```c
#pragma once

#include <stdint.h>


int32_t chessboard_calibration_get_mv(uint8_t file, uint8_t rank);
int chessboard_calibration_calibrate(void);
```

## src/watchdog.c
```c
#include <zephyr/kernel.h>
#include <zephyr/device.h>
#include <zephyr/drivers/watchdog.h>

#include <zephyr/logging/log.h>
#include <zephyr/init.h>

LOG_MODULE_REGISTER(watchdog_setup, LOG_LEVEL_INF);

static const struct device *const wdt = DEVICE_DT_GET(DT_ALIAS(watchdog0));

static int wdt_channel_id;

static int setup_watchdog(void)
{
	int err;

	if (!device_is_ready(wdt)) {
		LOG_ERR("Watchdog device not ready.");
		return -ENODEV;
	}

	struct wdt_timeout_cfg wdt_config = {
		/* Reset SoC when watchdog timer expires. */
		.flags = WDT_FLAG_RESET_SOC,

		/* Expire watchdog after 1000 ms */
		.window.min = 0,
		.window.max = 1000,
	};

	wdt_channel_id = wdt_install_timeout(wdt, &wdt_config);
	if (wdt_channel_id < 0) {
		LOG_ERR("Watchdog install error: %d", wdt_channel_id);
		return wdt_channel_id;
	}

	err = wdt_setup(wdt, 0);
	if (err < 0) {
		LOG_ERR("Watchdog setup error: %d", err);
		return err;
	}

	LOG_INF("Watchdog initialized, channel id: %d", wdt_channel_id);
	return 0;
};

void feed_watchdog(void)
{
	int err = wdt_feed(wdt, wdt_channel_id);
	if (err < 0) {
		LOG_ERR("Watchdog feed error: %d", err);
	}
}

SYS_INIT(setup_watchdog, POST_KERNEL, 0);
```

## src/watchdog.h
```c
#pragma once

void feed_watchdog(void);
```
